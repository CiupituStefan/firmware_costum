## boards/shields/ciupitu_stefan/Kconfig.defconfig
```kconfig
# Verifică dacă semnalizatorul definit în Kconfig.shield este activ
if SHIELD_CIUPITU_STEFAN

# Setează numele implicit al tastaturii
# ATENȚIE: Numele trebuie să aibă mai puțin de 16 caractere!
config ZMK_KEYBOARD_NAME
    default "Licenta2025"

# Aici poți adăuga și alte configurări implicite specifice shield-ului tău, dacă e necesar.
# De exemplu:
# config ZMK_SLEEP
#    default y

endif
```

## boards/shields/ciupitu_stefan/Kconfig.shield
```kconfig
# Numele shield-ului tău aici, fără spații după virgulă sau în nume!
# Folosește litere mici și underscore (_) în loc de spații pentru 'numele_mic_al_shieldului_tau'.
# Pentru 'NUMELE_MARE_AL_SHIELDULUI_TAU', folosește litere mari și underscore.

config SHIELD_CIUPITU_STEFAN
    def_bool $(shields_list_contains,ciupitu_stefan)
```
